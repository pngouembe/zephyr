## boards/arm/nucleo_f746zg/Kconfig.board
```kconfig
# Kconfig - NUCLEO-144 F429ZI  board configuration
#
# Copyright (c) 2017 Linaro Limited
#
# SPDX-License-Identifier: Apache-2.0
#

config BOARD_NUCLEO_F746ZG
	bool "NUCLEO-144 F746ZG Development Board"
	depends on SOC_STM32F746ZG
```

## drivers/can/Kconfig.stm32fd
```kconfig
# STM32 CAN configuration options

# Copyright (c) 2020 Alexander Wachter
# SPDX-License-Identifier: Apache-2.0

config CAN_STM32FD
	bool "STM32 CAN Driver"
	select CAN_FD_MODE
	depends on SOC_SERIES_STM32G4X || SOC_SERIES_STM32MP1X
	help
	  Enable STM32 CAN-FD Driver.
	  This diver supports the FDCAN IP from STM32G4 and STM32MP1 SoCs

if CAN_STM32FD

config CAN_MAX_STD_ID_FILTER
	int "Maximum number of std ID filters"
	default 5
	range 0 28
	help
	  Defines the maximum number of filters with standard ID (11-bit)
	  that can be attached.

config CAN_MAX_EXT_ID_FILTER
	int "Maximum number of ext ID filters"
	default 5
	range 0 8
	help
	  Defines the maximum number of filters with extended ID (29-bit)
	  that can be attached.

endif #CAN_STM32FD
```

## dts/bindings/can/can-fd-controller.yaml
```yaml
# Common fields for CAN-FD controllers

include: can-controller.yaml

properties:
    bus-speed-data:
      type: int
      required: true
      description: data phase bus speed in Baud/s
    sjw-data:
      type: int
      required: true
      description: Resynchronization jump width for the data phase. (ISO11898-1:2015)
    prop-seg-data:
      type: int
      required: true
      description: Time quantums of propagation segment for the data phase. (ISO11898-1:2015)
    phase-seg1-data:
      type: int
      required: true
      description: Time quantums of phase buffer 1 segment for the data phase. (ISO11898-1:2015)
    phase-seg2-data:
      type: int
      required: true
      description: Time quantums of phase buffer 2 segment for the data phase. (ISO11898-1:2015)
```

## dts/bindings/can/st,stm32-can-fd.yaml
```yaml
description: STM32 CAN controller

compatible: "st,stm32-can-fd"

include: can-fd-controller.yaml

properties:
    reg:
      required: true

    interrupts:
      required: true

    clocks:
      required: true
```

## subsys/can/Kconfig
```kconfig
# Kconfig - NET CAN Configuration

#
# Copyright (c) 2019 Alexander Wachter
#
# SPDX-License-Identifier: Apache-2.0
#

menu "CAN subsys"

source "subsys/can/isotp/Kconfig"

endmenu
```

## subsys/can/isotp/Kconfig
```kconfig
# Kconfig - ISO TP configuration options

#
# Copyright (c) 2019 Alexander Wachter
#
# SPDX-License-Identifier: Apache-2.0
#

menuconfig ISOTP
	bool "ISO-TP"
	select NET_BUF
	select POLL
	help
	  Enable ISO TP support for CAN

if ISOTP

module = CAN_ISOTP
module-str = CAN_ISOTP
source "subsys/logging/Kconfig.template.log_config"

config CAN_ISO_TP_WFTMAX
	int "WFTmax"
	default 10
	range 0 254
	help
	  This value defines the maximum number of WAIT frames before the transmission
	  is aborted.

config CAN_ISO_TP_BS_TIMEOUT
	int "Bs timeout [ms]"
	default 1000
	range 200 10000
	help
	  Timeout for the reception of the next FC frame. ISO 15765-2: 1000ms

config CAN_ISO_TP_A_TIMEOUT
	int "Ar and As timeout [ms]"
	default 1000
	range 200 10000
	help
	  As (sender transmit timeout) and Ar (receiver transmit timeout).
	  ISO 15765-2: 1000ms

config CAN_ISO_TP_CR_TIMEOUT
	int "Cr timeout [ms]"
	default 1000
	range 200 10000
	help
	  Cr (receiver consecutive frame) timeout.
	  ISO 15765-2: 1000ms

config CAN_ISOTP_WORKQUEUE_PRIO
	int "Priority level of the RX and TX work queue"
	default 2
	help
	  This value defines the priority level of the work queue thread that
	  handles flow control, consecutive sending, receiving and callbacks.

config CAN_ISOTP_RX_BUF_COUNT
	int "Number of data buffers for receiving data"
	default 4
	help
	  Each data buffer will occupy ISOTP_RX_BUF_SIZE + smallish
	  header (sizeof(struct net_buf)) amount of data.

config CAN_ISOTP_RX_BUF_SIZE
	int "Size of one buffer data block"
	default 56
	help
	  This value defines the size of a single block in the pool. The number of
	  blocks is given by ISOTP_RX_BUF_COUNT. To be efficient use a multiple of
		CAN_DL - 1 (for classic can : 8 - 1 = 7).

config CAN_ISOTP_RX_SF_FF_BUF_COUNT
	int "Number of SF and FF data buffers for receiving data"
	default 4
	help
	  This buffer is used for first and single frames. It is extra because the
	  buffer has to be ready for the first reception in isr context and therefor
	  is allocated when binding.
	  Each buffer will occupy CAN_DL - 1 byte + header (sizeof(struct net_buf))
	  amount of data.

config CAN_ISOTP_USE_TX_BUF
	bool "Buffer tx writes"
	default n
	help
	  Copy the outgoing data to a net buffer so that the calling function
	  can discard the data.

if CAN_ISOTP_USE_TX_BUF

config CAN_ISOTP_TX_BUF_COUNT
	int "Number of data buffers for sending data"
	default 4
	help
	  Each data buffer will occupy CONFIG_NET_BUF_DATA_SIZE + smallish
	  header (sizeof(struct net_buf)) amount of data. If context buffers
	  are used, use the same size here.

config CAN_ISOTP_BUF_TX_DATA_POOL_SIZE
	int "Size of the memory pool where buffers are allocated from"
	default 256
	help
	  This value defines the size of the memory pool where the buffers
	  for sending are allocated from.

endif # CAN_ISOTP_USE_TX_BUF

config CAN_ISOTP_ENABLE_CONTEXT_BUFFERS
	bool "Enable buffered tx contexts"
	default y
	help
	  This option enables buffered sending contexts. This makes send and
	  forget possible. A memory slab is used to buffer the context.

if CAN_ISOTP_ENABLE_CONTEXT_BUFFERS

config CAN_ISOTP_TX_CONTEXT_BUF_COUNT
	int "Amount of context buffers for sending data"
	default 4
	help
	  This defines the size of the memory slab where the buffers are
	  allocated from.

endif # CAN_ISOTP_ENABLE_CONTEXT_BUFFERS

endif # ISOTP
```

## subsys/net/l2/canbus/Kconfig
```kconfig
config NET_L2_CANBUS
	bool "Enable CANBUS L2 layer [Experimental]"
	depends on CAN_NET
	select NET_6LO
	help
	  Add a CANBUS L2 layer driver. This is the layer for IPv6 over CAN
	  (6loCAN). It uses IPHC to compress the IP header and ISO-TP for
	  flow control and reassembling.

if NET_L2_CANBUS

config NET_L2_CANBUS_USE_FIXED_ADDR
	bool "Use fixed L2 address"
	help
	  Use a fixed L2 address for 6LoCAN instead of a random chosen one

config NET_L2_CANBUS_FIXED_ADDR
	int "L2 address"
	depends on NET_L2_CANBUS_USE_FIXED_ADDR
	range 256 16367

config NET_L2_CANBUS_DAD_RETRIES
	int "Number of DAD retries"
	default 5
	help
	  Number of retries for Duplicate address detection.
	  Greater than one only makes sense for random link layer addresses.

module = NET_L2_CANBUS
module-dep = NET_LOG
module-str = Log level for CANbus L2 layer
module-help = Enables CANbus L2 to output debug messages.
source "subsys/net/Kconfig.template.log_config.net"
endif #NET_L2_CANBUS

config NET_L2_CANBUS_RAW
	bool "Enable CANBUS RAW l2 layer"
	help
	  Add a CANBUS L2 layer driver. This is the layer for SOCKET CAN.
```
